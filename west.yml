## west.yml
```yaml
manifest:
  defaults:
    remote: aur

  remotes:
    - name: aur
      url-base: https://aur.archlinux.org

  projects:
    - name: dtrx
    - name: google-chrome
    - name: google-talkplugin
    - name: libcurl-compat
    - name: spotify
    - name: slack-desktop
    - name: pidgin-sipe
    - name: jlink-software-and-documentation
    - name: ncurses5-compat-libs

  self:
    path: manifest
    west-commands: west-commands.yml
```
